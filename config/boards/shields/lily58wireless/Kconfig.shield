## config/boards/shields/lily58wireless/Kconfig.shield
```kconfig
# Copyright (c) 2020 Pete Johanson
# SPDX-License-Identifier: MIT

config SHIELD_LILY58WIRELESS_LEFT
	def_bool $(shields_list_contains,lily58wireless_left)

config SHIELD_LILY58WIRELESS_RIGHT
	def_bool $(shields_list_contains,lily58wireless_right)
```

## config/west.yml
```yaml
manifest:
  remotes:
    - name: zmkfirmware
      url-base: https://github.com/zmkfirmware
  # projects:
  #   - name: zmk
  #     remote: zmkfirmware
  #     revision: main
  #     import: app/west.yml
  projects:
    - name: zmk
      remote: Deemen17
      revision: display/bongo-cat-widget
      import: app/west.yml
  self:
    path: config
```
